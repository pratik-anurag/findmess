## firmware/lost-tag/sdkconfig.defaults
```kconfig
CONFIG_BT_ENABLED=y
CONFIG_BT_BLE_ENABLED=y
CONFIG_MBEDTLS_HKDF_C=y
CONFIG_LOG_DEFAULT_LEVEL_INFO=y
CONFIG_PM_ENABLE=y
```

## firmware/merchant-stand/sdkconfig.defaults
```kconfig
CONFIG_BT_ENABLED=y
CONFIG_BT_BLE_ENABLED=y
CONFIG_ESP_WIFI_ENABLED=y
CONFIG_ESP_HTTP_CLIENT_ENABLE_HTTPS=y
CONFIG_ESP_HTTPS_OTA=y
CONFIG_PARTITION_TABLE_TWO_OTA=y
CONFIG_MBEDTLS_HKDF_C=y
CONFIG_LOG_DEFAULT_LEVEL_INFO=y
```
